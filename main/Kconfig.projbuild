## main/Kconfig.projbuild
```kconfig
menu "Project Settings"

    orsource "$IDF_PATH/examples/common_components/env_caps/$IDF_TARGET/Kconfig.env_caps"

    config BLINK_GPIO
        int "LED GPIO"
        range ENV_GPIO_RANGE_MIN ENV_GPIO_OUT_RANGE_MAX
        default 5 if IDF_TARGET_ESP32
        default 18 if IDF_TARGET_ESP32S2
        default 48 if IDF_TARGET_ESP32S3
        default 8
        help
            GPIO number (IOxx) to blink on and off or the RMT signal for the addressable LED.
            Some GPIOs are used for other purposes (flash connections, etc.) and cannot be used to blink.

    config WIFI_CHANNEL
        int "WiFi Channel"
        range 1 13
        default 1
        help
            WiFi channel to use for the ESP32 station interface.

    config TIME_WIFI_SSID
        string "WiFi SSID"
        default "myssid"
        help
            WiFi SSID to connect to for SNTP time synchronization.

    config TIME_WIFI_PASSWORD
        string "WiFi Password"
        default "mypassword"
        help
            WiFi password to connect to for SNTP time synchronization.

    config TIME_NTP_SERVER
        string "NTP Server"
        default "pool.ntp.org"
        help
            NTP server to use for time synchronization.

endmenu
```
